## sdkconfig.defaults
```kconfig
# MIPI-DSI Configuration for ESP32-P4
CONFIG_MIPI_DSI_ENABLED=y
CONFIG_MIPI_DSI_BUS_COUNT=1
CONFIG_MIPI_DSI_SUPPORT=y

# LCD Panel Support
CONFIG_ESP_LCD_MIPI_DSI_SUPPORTED=y
CONFIG_ESP_LCD_EK79007_SUPPORTED=y

# PSRAM
CONFIG_ESP_PSRAM=y
CONFIG_SPIRAM=y
CONFIG_SPIRAM_SPEED_80M=y
CONFIG_SPIRAM_USE_MALLOC=y
CONFIG_SPIRAM_FETCH_INSTRUCTIONS=y
CONFIG_SPIRAM_RODATA=y

# LDO for MIPI DSI PHY
CONFIG_PM_SUPPORT=y
CONFIG_PM_POWER_DOWN_PERIPHERAL_IN_LIGHT_SLEEP=y

# USB
CONFIG_USB_OTG_SUPPORTED=y

# Arduino main task stack size - increased for MIPI-DSI init
CONFIG_ARDUINO_LOOP_STACK_SIZE=32768

# ISR IRAM-safe flags for PSRAM cache coherency
CONFIG_RMT_ISR_IRAM_SAFE=y
CONFIG_GPTIMER_ISR_IRAM_SAFE=y

# Interrupt watchdog — see ESP-IDF wdts.rst: tick ISR must run within this window.
# PSRAM + MIPI-DSI flush + heavy lv_timer_handler() can defer interrupts; 800ms was still tight in practice.
CONFIG_ESP_INT_WDT_TIMEOUT_MS=2000
```
